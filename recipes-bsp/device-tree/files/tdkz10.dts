/dts-v1/;
/include/ "topic-miami-florida-mio.dtsi"
/include/ "topic-miamilite.dtsi"

/* Fix up signals on florida */

&gpioexf {
	interrupts = <46 0x8>; /* GPIO 46, IRQ_TYPE_LEVEL_LOW */
};

&usb_phy0 {
	reset-gpios = <&gpio0 0 1>;
};
