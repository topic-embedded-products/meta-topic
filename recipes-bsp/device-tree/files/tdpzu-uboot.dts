#include "tdpzu.dts"

/* Run QSPI at 40MHz. Some bug in u-boot corrupts the data at higher speeds */
&qspi {
	flash@0 {
		spi-max-frequency = <40000000>;
	};
};

&sdhci1 {
	/* No UHS capability in u-boot */
	no-1-8-v; 
};
