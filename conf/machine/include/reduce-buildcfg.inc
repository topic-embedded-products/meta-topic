## conf/machine/include/tepzu9/tepzu9-cortexa53-fsbl-features.conf
```bitbake
MACHINE_FEATURES = "avbuf axipmon canps clockps common coresightps-dcc csudma ddrcpsu dpdma dppsu emacps gpiops iic iicps ipipsu pciepsu qspipsu resetps rtcpsu scugic sdps spips sysmonpsu ttcps uartps usbpsu video-common wdtps zdma"
```

## conf/machine/include/tepzu9/tepzu9-microblaze-pmu-features.conf
```bitbake
MACHINE_FEATURES = "avbuf axipmon canps clockps common csudma ddrcpsu dpdma dppsu emacps gpiops iic iicps ipipsu pciepsu qspipsu resetps rtcpsu sdps spips sysmonpsu ttcps uartps usbpsu video-common wdtps zdma"
```

## conf/machine/include/tepzu9/tepzu9-microblaze-pmu-libxil.conf
```bitbake
PACKAGECONFIG[avbuf] = "${RECIPE_SYSROOT}/usr/lib/libavbuf.a,,avbuf,,"
PACKAGECONFIG[axipmon] = "${RECIPE_SYSROOT}/usr/lib/libaxipmon.a,,axipmon,,"
PACKAGECONFIG[canps] = "${RECIPE_SYSROOT}/usr/lib/libcanps.a,,canps,,"
PACKAGECONFIG[clockps] = "${RECIPE_SYSROOT}/usr/lib/libclockps.a,,clockps,,"
PACKAGECONFIG[common] = "${RECIPE_SYSROOT}/usr/lib/libcommon.a,,common,,"
PACKAGECONFIG[csudma] = "${RECIPE_SYSROOT}/usr/lib/libcsudma.a,,csudma,,"
PACKAGECONFIG[ddrcpsu] = "${RECIPE_SYSROOT}/usr/lib/libddrcpsu.a,,ddrcpsu,,"
PACKAGECONFIG[dpdma] = "${RECIPE_SYSROOT}/usr/lib/libdpdma.a,,dpdma,,"
PACKAGECONFIG[dppsu] = "${RECIPE_SYSROOT}/usr/lib/libdppsu.a,,dppsu,,"
PACKAGECONFIG[emacps] = "${RECIPE_SYSROOT}/usr/lib/libemacps.a,,emacps,,"
PACKAGECONFIG[gpiops] = "${RECIPE_SYSROOT}/usr/lib/libgpiops.a,,gpiops,,"
PACKAGECONFIG[iic] = "${RECIPE_SYSROOT}/usr/lib/libiic.a,,iic,,"
PACKAGECONFIG[iicps] = "${RECIPE_SYSROOT}/usr/lib/libiicps.a,,iicps,,"
PACKAGECONFIG[ipipsu] = "${RECIPE_SYSROOT}/usr/lib/libipipsu.a,,ipipsu,,"
PACKAGECONFIG[pciepsu] = "${RECIPE_SYSROOT}/usr/lib/libpciepsu.a,,pciepsu,,"
PACKAGECONFIG[qspipsu] = "${RECIPE_SYSROOT}/usr/lib/libqspipsu.a,,qspipsu,,"
PACKAGECONFIG[resetps] = "${RECIPE_SYSROOT}/usr/lib/libresetps.a,,resetps,,"
PACKAGECONFIG[rtcpsu] = "${RECIPE_SYSROOT}/usr/lib/librtcpsu.a,,rtcpsu,,"
PACKAGECONFIG[sdps] = "${RECIPE_SYSROOT}/usr/lib/libsdps.a,,sdps,,"
PACKAGECONFIG[spips] = "${RECIPE_SYSROOT}/usr/lib/libspips.a,,spips,,"
PACKAGECONFIG[sysmonpsu] = "${RECIPE_SYSROOT}/usr/lib/libsysmonpsu.a,,sysmonpsu,,"
PACKAGECONFIG[ttcps] = "${RECIPE_SYSROOT}/usr/lib/libttcps.a,,ttcps,,"
PACKAGECONFIG[uartps] = "${RECIPE_SYSROOT}/usr/lib/libuartps.a,,uartps,,"
PACKAGECONFIG[usbpsu] = "${RECIPE_SYSROOT}/usr/lib/libusbpsu.a,,usbpsu,,"
PACKAGECONFIG[video-common] = "${RECIPE_SYSROOT}/usr/lib/libvideo_common.a,,video-common,,"
PACKAGECONFIG[wdtps] = "${RECIPE_SYSROOT}/usr/lib/libwdtps.a,,wdtps,,"
PACKAGECONFIG[zdma] = "${RECIPE_SYSROOT}/usr/lib/libzdma.a,,zdma,,"
```

## conf/machine/tepzu9.conf
```bitbake
#@TYPE: Machine
#@NAME: tepzu9
#@DESCRIPTION: Machine configuration for the tepzu9 boards.

FPGA_FAMILY = "xczu9eg"
FPGA_PART = "xczu9eg-ffvb1156-1-i"

require conf/machine/include/tspzu.inc

# Original SDT artifacts URL
SDT_URI = "http://fpga-server.local/downloads/fpga/tepzu-reference/fpga-image-tepzu-reference-tepzu9-1+b848b43-sdt.tar.xz"
SDT_URI[sha256sum] = "b44602b2ae0a79a2ea24b7e89c30b406b29a2d9b979a516f9d5d55e9bc082969"

# Devicetree stuff
BOARD_PL_REFERENCE = "dtb-tepzu-reference"

MACHINE_WIFI_DRIVERS = "\
	kernel-module-cfg80211 \
	kernel-module-mac80211 \
	kernel-module-libarc4 \
	kernel-module-iwlwifi \
	kernel-module-iwlmvm \
	linux-firmware-iwlwifi-ax200 \
	"
MACHINE_BT_DRIVERS = "\
	kernel-module-bluetooth \
	kernel-module-btmrvl \
	kernel-module-btusb \
	linux-firmware-ibt-20 \
	"

# Extra packages to install for the board
MACHINE_EXTRA_RRECOMMENDS += "\
	kernel-module-lima \
	kernel-module-u-ether \
	kernel-module-usb-f-ecm \
	kernel-module-usb-f-ecm-subset \
	kernel-module-usb-f-mass-storage \
	kernel-module-usb-f-rndis \
	"

MACHINE_FEATURES_EXTRA += "usbhost usbgadget ethernet powerkey screen"
```
