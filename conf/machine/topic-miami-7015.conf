## conf/machine/topic-miami-7015.conf
```bitbake
#@TYPE: Machine
#@DESCRIPTION: Machine configuration for the Topic Miami SOM with 7z015
require conf/machine/include/topic-miami.inc
```

## conf/machine/topic-miami-7030.conf
```bitbake
#@TYPE: Machine
#@DESCRIPTION: Machine configuration for the Topic Miami SOM with 7z030
require conf/machine/include/topic-miami.inc
```

## conf/machine/xdpzu7.conf
```bitbake
MACHINE_BOARD = "topic-miamimp-xilinx-xdp"
FPGA_FAMILY = "xczu7ev"
FPGA_FAMILY_SHORT = "xczu"
FPGA_PART = "xczu7ev-fbvb900-2-i"
# Should be "ev" but the video stuff is not working yet and the mali
# support breaks the build, so just claim it isn't there.
SOC_VARIANT = ""

require conf/machine/include/topic-miamimp.inc

UBOOT_MACHINE = "topic_miamimp_xilinx_xdp_config"

BOARD_PL_REFERENCE = "dtb-xdp-reference"

# For "wic" images
DEVICETREE = "devicetree/zynqmp-topic-miamimp-xilinx-xdp.dtb"
DEVICETREE_topic-desktop = "devicetree/zynqmp-topic-miamimp-xilinx-xdp-usbhost.dtb"

DEVICETREELINKS = "\
	system.dtb  devicetree/zynqmp-topic-miamimp-xilinx-xdp.dtb \n \
	system-mmc1.dtb  devicetree/zynqmp-topic-miamimp-xilinx-xdp-sd.dtb \n \
	"
DEVICETREELINKS_topic-desktop = "\
	system.dtb  devicetree/zynqmp-topic-miamimp-xilinx-xdp-usbhost.dtb \n \
	system-mmc1.dtb  devicetree/zynqmp-topic-miamimp-xilinx-xdp-sd-usbhost.dtb \n \
	"

MACHINE_FEATURES += "wifi alsa ethernet bluetooth"

# Extra packages to install for the board
MACHINE_EXTRA_RRECOMMENDS += "\
	linux-firmware-bcm43430 \
	murata-firmware \
	kernel-module-topic-pl-fanctrl \
	kernel-module-hdmi \
	kernel-module-pwm \
	kernel-module-brcmfmac \
	kernel-module-g-ether \
	kernel-module-usb-f-rndis \
	kernel-module-uio-pdrv-genirq \
	pwm-fancontrol \
	"

KERNEL_MODULE_AUTOLOAD += "brcmfmac g_ether"
```

## conf/machine/zedboard.conf
```bitbake
#@TYPE: Machine
#@Name: Xilinx Zedboard FPGA Development Platform for the Zynq-7020 processor.
#@DESCRIPTION: Machine configuration for the Zedboard.

include conf/machine/include/zynq-base.inc
include conf/machine/include/tune-cortexa9.inc

PREFERRED_PROVIDER_virtual/xilinx-sdk ?= "fpga-image-adi"

UBOOT_MACHINE = "zynq_zed_config"
#UBOOT_ENTRYPOINT = "0x40000000"
#UBOOT_LOADADDRESS = "0x40000000"

# UBI parameters copied from zc702 board, have to be verified
# do ubiattach /dev/ubi_ctrl -m 4
# From dmesg:
#  UBI: physical eraseblock size:   65536 bytes (64 KiB)
#  UBI: logical eraseblock size:    65408 bytes
#  UBI: smallest flash I/O unit:    1
# from ubiattach stdout:
#  total 88 LEBs
MKUBIFS_ARGS = "-m 1 -e 65408 -c 440"
UBINIZE_ARGS = "-m 1 -p 64KiB"
UBI_VOLNAME = "qspi-rootfs"

MACHINE_EXTRA_RRECOMMENDS = "zed-audio zed-oled-load"
```

## conf/machine/zynq-miami-7015.conf
```bitbake
#@TYPE: Machine
#@DESCRIPTION: Machine configuration for the Zynq-Miami SOM with 7015
require conf/machine/include/zynq-miami.inc
```

## conf/machine/zynq-miami-7030.conf
```bitbake
#@TYPE: Machine
#@DESCRIPTION: Machine configuration for the Zynq-Miami SOM with 7030
require conf/machine/include/zynq-miami.inc
```

## conf/machine/zynq-miami.conf
```bitbake
#@TYPE: Machine
#@DESCRIPTION: Machine configuration for the Zynq-Miami SOM.

include conf/machine/include/zynq-base.inc
include conf/machine/include/tune-cortexa9.inc

PREFERRED_PROVIDER_virtual/xilinx-sdk ?= "fpga-image-miami"

UBOOT_MACHINE = "zynq_miami_config"
#UBOOT_ENTRYPOINT = "0x40000000"
#UBOOT_LOADADDRESS = "0x40000000"

# UBI parameters copied from zc702 board, have to be verified
# do ubiattach /dev/ubi_ctrl -m 4
# From dmesg:
#  UBI: physical eraseblock size:   65536 bytes (64 KiB)
#  UBI: logical eraseblock size:    65408 bytes
#  UBI: smallest flash I/O unit:    1

# TODO: Fix block count for 64M flash
MKUBIFS_ARGS = "-m 1 -e 65408 -c 440"
UBINIZE_ARGS = "-m 1 -p 64KiB"
UBI_VOLNAME = "qspi-rootfs"
```

## conf/machine/zynq-zc702.conf
```bitbake
#@TYPE: Machine
#@Name: Xilinx ZC702 FPGA Development Platform for the Zynq-7020 processor.
#@DESCRIPTION: Machine configuration for the Xilinx ZC702 FPGA Development Platform.

include conf/machine/include/zynq-base.inc
include conf/machine/include/tune-cortexa9.inc

IMAGE_FSTYPES = "tar.gz ubi squashfs"

UBOOT_MACHINE = "zynq_zc70x_config"
#UBOOT_ENTRYPOINT = "0x40000000"
#UBOOT_LOADADDRESS = "0x40000000"

# do ubiattach /dev/ubi_ctrl -m 4
# From dmesg:
#  UBI: physical eraseblock size:   65536 bytes (64 KiB)
#  UBI: logical eraseblock size:    65408 bytes
#  UBI: smallest flash I/O unit:    1
# from ubiattach stdout:
#  total 88 LEBs
MKUBIFS_ARGS = "-m 1 -e 65408 -c 184"
UBINIZE_ARGS = "-m 1 -p 64KiB"
UBI_VOLNAME = "qspi-rootfs"
```

## conf/machine/zynq-zc706.conf
```bitbake
#@TYPE: Machine
#@Name: Xilinx ZC706 FPGA Development Platform

include conf/machine/include/zynq-base.inc
include conf/machine/include/tune-cortexa9.inc

PREFERRED_PROVIDER_virtual/xilinx-sdk ?= "fpga-image-adi-vivado"
MACHINE_FPGA_BITSTREAM ?= "fpga-image-adi-vivado"
BOARD_FPGA_PACKAGES ?= "adi-hdmi-load"

MACHINE_FEATURES += "rtc"

UBOOT_MACHINE = "zynq_zc70x_config"
#UBOOT_ENTRYPOINT = "0x40000000"
#UBOOT_LOADADDRESS = "0x40000000"

# do ubiattach /dev/ubi_ctrl -m 4
# From dmesg:
#  UBI: physical eraseblock size:   65536 bytes (64 KiB)
#  UBI: logical eraseblock size:    65408 bytes
#  UBI: smallest flash I/O unit:    1
# from ubiattach stdout:
#  total 88 LEBs
MKUBIFS_ARGS = "-m 1 -e 65408 -c 184"
UBINIZE_ARGS = "-m 1 -p 64KiB"
UBI_VOLNAME = "qspi-rootfs"
```

## recipes-bsp/u-boot/u-boot-xlnx/topic_tdkz_defconfig
```kconfig
CONFIG_ARM=y
CONFIG_SYS_VENDOR="topic"
CONFIG_SYS_CONFIG_NAME="topic_miami"
CONFIG_SPL_SYS_DCACHE_OFF=y
CONFIG_ARCH_ZYNQ=y
CONFIG_SYS_TEXT_BASE=0x4000000
CONFIG_SPL_STACK_R_ADDR=0x200000
CONFIG_SPL=y
CONFIG_DEBUG_UART_BASE=0xe0000000
CONFIG_DEBUG_UART_CLOCK=100000000
CONFIG_IDENT_STRING="Topic Miami SoC TDK"
CONFIG_DEBUG_UART=y
CONFIG_DISTRO_DEFAULTS=y
CONFIG_FIT=y
CONFIG_FIT_VERBOSE=y
CONFIG_SPL_LOAD_FIT=y
CONFIG_SYS_CUSTOM_LDSCRIPT=y
CONFIG_SYS_LDSCRIPT="arch/arm/mach-zynq/u-boot.lds"
CONFIG_BOOTDELAY=0
CONFIG_LOGLEVEL=7
CONFIG_SPL_STACK_R=y
CONFIG_SPL_SPI_LOAD=y
CONFIG_BOARD_EARLY_INIT_R=y
CONFIG_SYS_PROMPT="zynq-uboot> "
CONFIG_CMD_BOOTMENU=y
CONFIG_CMD_THOR_DOWNLOAD=y
CONFIG_CMD_MEMTEST=y
CONFIG_SYS_ALT_MEMTEST=y
CONFIG_CMD_BIND=y
CONFIG_CMD_CLK=y
CONFIG_CMD_DFU=y
# CONFIG_CMD_FLASH is not set
CONFIG_CMD_FPGA_LOADBP=y
CONFIG_CMD_FPGA_LOADP=y
CONFIG_CMD_FPGA_LOAD_SECURE=y
CONFIG_CMD_GPIO=y
CONFIG_CMD_GPT=y
CONFIG_CMD_I2C=y
CONFIG_CMD_MMC=y
CONFIG_CMD_MTD=y
CONFIG_CMD_SF=y
CONFIG_CMD_SPI=y
CONFIG_CMD_USB=y
CONFIG_CMD_USB_MASS_STORAGE=y
CONFIG_CMD_TFTPPUT=y
CONFIG_CMD_TIME=y
CONFIG_CMD_TIMER=y
CONFIG_CMD_FRU=y
CONFIG_CMD_EXT4_WRITE=y
CONFIG_CMD_MTDPARTS=y
CONFIG_MTDIDS_DEFAULT="nor0=spi0.0"
CONFIG_MTDPARTS_DEFAULT="mtdparts=spi0.0:0x60000(qspi-boot-bin),0x100000(qspi-u-boot-itb),0x20000(qspi-u-boot-env),-(qspi-rootfs)"
CONFIG_CMD_UBI=y
# CONFIG_CMD_SETEXPR is not set
# CONFIG_CMD_NET is not set
CONFIG_CMD_CACHE=y
CONFIG_OF_EMBED=y
CONFIG_DEFAULT_DEVICE_TREE="zynq-topic-miami"
CONFIG_SPL_DM=y
CONFIG_SPL_DM_SEQ_ALIAS=y
CONFIG_DFU_MMC=y
CONFIG_DFU_RAM=y
CONFIG_USB_FUNCTION_FASTBOOT=y
CONFIG_FASTBOOT_FLASH=y
CONFIG_FASTBOOT_FLASH_MMC_DEV=0
CONFIG_FASTBOOT_CMD_OEM_FORMAT=y
CONFIG_FPGA_XILINX=y
CONFIG_FPGA_ZYNQPL=y
CONFIG_DM_GPIO=y
CONFIG_GPIO_HOG=y
CONFIG_XILINX_GPIO=y
CONFIG_DM_PCA953X=y
CONFIG_DM_I2C=y
CONFIG_SYS_I2C_CADENCE=y
CONFIG_I2C_MUX=y
CONFIG_I2C_MUX_PCA954x=y
CONFIG_LED=y
CONFIG_LED_GPIO=y
CONFIG_MISC=y
CONFIG_I2C_EEPROM=y
CONFIG_SUPPORT_EMMC_BOOT=y
CONFIG_MMC_IO_VOLTAGE=y
CONFIG_MMC_UHS_SUPPORT=y
CONFIG_MMC_HS200_SUPPORT=y
CONFIG_MMC_SDHCI=y
CONFIG_MMC_SDHCI_ZYNQ=y
CONFIG_MTD=y
CONFIG_SPI_FLASH=y
CONFIG_SPI_FLASH_BAR=y
CONFIG_SF_DUAL_FLASH=y
CONFIG_SPI_GENERIC=y
CONFIG_SPI_FLASH_ISSI=y
CONFIG_SPI_FLASH_MACRONIX=y
CONFIG_SPI_FLASH_SPANSION=y
CONFIG_SPI_FLASH_STMICRO=y
CONFIG_SPI_FLASH_SST=y
CONFIG_SPI_FLASH_WINBOND=y
# CONFIG_SPI_FLASH_USE_4K_SECTORS is not set
CONFIG_SPI_FLASH_MTD=y
CONFIG_SCSI=y
CONFIG_DM_SCSI=y
CONFIG_ARM_DCC=y
CONFIG_MTD_UBI_BEB_LIMIT=0
CONFIG_DEBUG_UART_ZYNQ=y
CONFIG_DEBUG_UART_ANNOUNCE=y
CONFIG_ZYNQ_SERIAL=y
CONFIG_SPI=y
CONFIG_ZYNQ_QSPI=y
CONFIG_USB=y
CONFIG_USB_EHCI_HCD=y
CONFIG_USB_ULPI_VIEWPORT=y
CONFIG_USB_ULPI=y
CONFIG_USB_GADGET=y
CONFIG_USB_GADGET_MANUFACTURER="Xilinx"
CONFIG_USB_GADGET_VENDOR_NUM=0x03fd
CONFIG_USB_GADGET_PRODUCT_NUM=0x0300
CONFIG_CI_UDC=y
CONFIG_USB_GADGET_DOWNLOAD=y
CONFIG_USB_FUNCTION_THOR=y
# CONFIG_FAT_WRITE is not set
CONFIG_PANIC_HANG=y
CONFIG_REGEX=y
CONFIG_SPL_GZIP=y
CONFIG_OF_LIBFDT_OVERLAY=y
CONFIG_EFI_LOADER_BOUNCE_BUFFER=y
CONFIG_CMD_BOOTI=y
```

## scripts/templates/build/conf/bblayers.conf
```bitbake
# LAYER_CONF_VERSION is increased each time build/conf/bblayers.conf
# changes incompatibly
LCONF_VERSION = "7"

# Top dir is three dirs back
LAYERTOPDIR := "${@os.path.dirname(os.path.dirname(os.path.dirname(d.getVar('FILE', True))))}"

BBPATH = "${TOPDIR}"
BBFILES ?= ""

BBLAYERS = " \
  ${LAYERTOPDIR}/oe-core/meta \
  ${LAYERTOPDIR}/meta-oe/meta-oe \
  ${LAYERTOPDIR}/meta-xilinx/meta-xilinx-bsp \
  ${LAYERTOPDIR}/meta-xilinx/meta-xilinx-standalone \
  ${LAYERTOPDIR}/meta-swupdate \
  ${LAYERTOPDIR}/meta-topic \
  "
```

## wic/sdimage-swu.wks
```
# SD card image with a bootable EXT4 partition and only boot files in first part
part --source bootimg-partition --fstype=vfat --label boot --align 4 --size 2
part --source rootfs --fstype=ext4 --label rootfs --active --align 256
```
