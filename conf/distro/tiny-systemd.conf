## conf/machine/include/topic-miamimp.inc
```bitbake
#@TYPE: Machine
#@DESCRIPTION: Machine support for Topic Miami MPSoC.
#
# Machine config is expected to set MACHINE_BOARD and FPGA_FAMILY

# The system-on-module contains flash, CPU+FPGA, RAM and various power supply
# and clock sources.
SOM_FAMILY = "topic-miamimp"

# The kernel also only depends on the board, not the FPGA
KMACHINE = "${MACHINE_BOARD}"

# Most boards will have a reference design for the machine. This is usually a
# single package that RDEPENDS on the FPGA image and other needful things.
BOARD_PL_REFERENCE ??= ""

# IMAGE_INSTALL_MACHINE_EXTRAS is used in my-image.bb and will thus by default
# install the reference design package. If you don't want the reference design,
# just set BOARD_PL_REFERENCE="" in your my-image derived image recipe.
IMAGE_INSTALL_MACHINE_EXTRAS = "packagegroup-machine-base ${BOARD_PL_REFERENCE}"

# There's no entropy source in the SoM, so use 'haveged' to at least make the
# ssh server start up in reasonable time.
MACHINE_ENTROPY = "haveged-once"
MACHINE_EXTRA_RDEPENDS += "${MACHINE_ENTROPY}"

KERNEL_MODULE_AUTOLOAD ?= ""

# Most topic modules carry the "eg" variant (quad-core CPU with MALI GPU)
SOC_VARIANT ?= "eg"

# The SOM_FAMILY is more specific than the SOC_FAMILY (=zynqmp) in the MACHINEOVERRIDES
MACHINEOVERRIDES =. "${SOM_FAMILY}:${MACHINE_BOARD}:${FPGA_FAMILY}:"

# The zynqmp is a CortexA53, no need to be binary compatible with other CPUs
# This is a strange place to do this. Note that you'll have to remove this when
# attempting to build the PMU firmware.
DEFAULTTUNE = "cortexa53"

require conf/machine/zynqmp-generic.conf
# Undo what Xilinx did, there's nothing that we want, so make it empty
MACHINE_ESSENTIAL_EXTRA_RDEPENDS = ""

# Remove the unneeded boot config/script, not needed for topic boards, but they
# get added unconditionally by zynqmp-generic.conf.
EXTRA_IMAGEDEPENDS:remove = "u-boot-xlnx-uenv u-boot-xlnx-scr"
# We have our own bootscript
EXTRA_IMAGEDEPENDS += "bootscript"

# Get rid of QEMU dependency, work around build failures
IMAGE_CLASSES:remove = "image-types-xilinx-qemu"
IMAGE_FSTYPES:remove = "wic.qemu-sd"
EXTRA_IMAGEDEPENDS:remove = "qemu-system-native qemu-helper-native:do_addto_recipe_sysroot"
PREFERRED_PROVIDER_qemu-helper-native ?= "qemu-helper-native"
PREFERRED_PROVIDER_qemu = "qemu"
PREFERRED_PROVIDER_qemu-native = "qemu-native"
PREFERRED_PROVIDER_qemu-system-native = "qemu-system-native"
PREFERRED_PROVIDER_nativesdk-qemu = "nativesdk-qemu"

# Out of kernel devicetree
PREFERRED_PROVIDER_virtual/dtb = "device-tree-static"
MACHINE_ESSENTIAL_EXTRA_RDEPENDS += "device-tree-static"

# The RTC only works if a battery is connected, which most boards do not have
MACHINE_FEATURES_BACKFILL_CONSIDERED = "rtc"
# Sanitize the MACHINE_FEATURES (otherwise we get wifi, bluetooth and more)
MACHINE_FEATURES = "ext2 ext3 vfat usbhost fpgamgr"

SERIAL_CONSOLE = "115200 ttyPS0"
# We only want to run getty on the console.
SERIAL_CONSOLES = "115200;ttyPS0"

# Use QSPI flash with 128k sector size, 128MB total size
MKUBIFS_ARGS = "-m 1 -e 130944 -c 1012 -x zlib"
UBINIZE_ARGS = "-m 1 -p 128KiB"
UBI_VOLNAME = "qspi-rootfs"

# WIC image support.
DEVICETREE ??= "devicetree/zynqmp-topic-miamimp.dtb"
WKS_FILE = "sdimage-swu.wks"
# Xilinx sets WKS_FILES instead of WKS_FILE, so we're forced to do that here too
WKS_FILES = "${WKS_FILE}"
IMAGE_BOOT_FILES = "boot.bin"
IMAGE_OVERHEAD_FACTOR="1.1"

# Xilinx sets WKS_FILE_DEPENDS:append which we'll undo here. We only want boot.bin there anyway...
WKS_FILE_DEPENDS:remove = "virtual/dtb u-boot-xlnx-uenv u-boot-xlnx-scr arm-trusted-firmware"

# HACK (xilins prepends file:// and appends .elf
# FSBL_FILE = "${HOME}/projects/topic-platform-langdale/fsbl-${MACHINE}"

# Do not add device-tree or bitstream to boot.bin, they're not needed
BIF_DEVICETREE_ATTR = ""
BIF_BITSTREAM_ATTR = ""

# TLD uses this revision
TOPIC_XSA_DESIGN_VERSION ?= "179+bcff7f6"
TOPIC_XSA_DESIGN_NAME ?= "fpga-hardware-${HDF_MACHINE}-reference-${TOPIC_XSA_DESIGN_VERSION}.xsa"

# Setup things for external-hdf.bb
# Note: Update the checksums in "external-hdf.bbappend" when the reference designs change
HDF_MACHINE = "${MACHINE}"
HDF_BASE = "http://"
HDF_PATH = "fpga-server.local/downloads/fpga/fpga-board-utils/${TOPIC_XSA_DESIGN_NAME}.xz;name=${HDF_MACHINE}"
HDF_NAME = "${S}/${TOPIC_XSA_DESIGN_NAME}"
```

## conf/machine/include/topic-miamiplus-florida-test.inc
```bitbake
# Florida board common components
require conf/machine/include/topic-miamiplus.inc

MACHINE_FPGA_BITSTREAM ?= ""

# Extra packages to install for the board
BOARD_FPGA_PACKAGES ?= "\
	kernel-module-g-ether \
	kernel-module-g-mass-storage \
	kernel-module-g-ncm \
	kernel-module-gspca-main \
	kernel-module-u-ether \
	kernel-module-pwc \
	kernel-module-usb-f-ecm \
	kernel-module-usb-f-ecm-subset \
	kernel-module-usb-f-mass-storage \
	kernel-module-usb-f-ncm \
	kernel-module-usb-f-rndis \
	kernel-module-usbserial \
	kernel-module-uvcvideo \
	"

MACHINE_FEATURES += "usbhost usbgadget"

DEVICETREE = "uImage-topic-miamiplus-florida-test.dtb"
```

## conf/machine/include/topic-miamiplus.inc
```bitbake
# The miami plus boards have extra I/O connectors and slightly different hardware
require conf/machine/include/topic-miami.inc

# This makes the "topic-miamiplus" override work
SOM_FAMILY = "topic-miamiplus"

# But the "topic-miami" override applies as well, with lower priority
MACHINEOVERRIDES =. "topic-miami:"

# Different flash layout, hence different u-boot
UBOOT_MACHINE = "topic_miamiplus_config"
UBOOT_USER_SPECIFIED_DTS = "zynq-topic-miamiplus"

# Use QSPI flash with 128k sector size (dual parallel qspi flash)
MKUBIFS_ARGS = "-m 1 -e 130944 -c 472 -x zlib"
UBINIZE_ARGS = "-m 1 -p 128KiB"
UBI_VOLNAME = "qspi-rootfs"
```

## conf/machine/include/zynq-base.inc
```bitbake
# Provides the Xilinx Zynq common settings

include conf/machine/include/zynq-default-providers.inc

# Define a machine class for common zynq platforms
MACHINE_CLASS = "zynq"

# Add u-boot image to rootfs
EXTRA_IMAGEDEPENDS = "virtual/bootloader sd-bootscript"

# Most boards will have a reference design for the machine. This is usually a
# single package that RDEPENDS on the FPGA image and other needful things.
BOARD_PL_REFERENCE ??= ""

# IMAGE_INSTALL_MACHINE_EXTRAS is used in my-image.bb and will thus by default
# install the reference design package. If you don't want the reference design,
# just set BOARD_PL_REFERENCE="" in your my-image derived image recipe.
IMAGE_INSTALL_MACHINE_EXTRAS = "packagegroup-machine-base ${BOARD_PL_REFERENCE}"

# Specify kernel image type
KERNEL_IMAGETYPE = "uImage"

# If we have an rtc, we'll tell it
MACHINE_FEATURES_BACKFILL_CONSIDERED = "rtc"

# Specify machine features
MACHINE_FEATURES = "vfat fpgamgr"

# Specify rootfs image filesystem types
IMAGE_FSTYPES = "tar.gz"

# Specify serial console settings
SERIAL_CONSOLE = "115200 ttyPS0"

# Default FGPA architecture is the machine
FPGA_FAMILY ??= "${MACHINE}"

# XILINX tool locations (for in your site.conf) and input files
# Override them in local.conf to suit your system

# Use the "32" or "64" toolchain
XILINX_TOOL_ARCH ?= "64"
# The base install directory for Vivado
XILINX_VIVADO_VERSION ??= "2019.1"
XILINX_VIVADO_PATH ?= "/opt/Xilinx/Vivado/${XILINX_VIVADO_VERSION}"
# Your LM_LICENSE_FILE is usually removed by Bitbake
XILINX_LM_LICENSE_FILE ?= "${XILINX_VIVADO_PATH}/data/ip/core_licenses/Xilinx.lic"

# WIC image support.
DEVICETREE ??= "zynq-7000.dtb"
WKS_FILE = "sdimage-bootpart.wks"
IMAGE_BOOT_FILES = "boot.bin u-boot.img uImage boot.scr ${DEVICETREE};devicetree.dtb"
do_image_wic[depends] += "mtools-native:do_populate_sysroot dosfstools-native:do_populate_sysroot"
```

## conf/machine/include/zynq-miami.inc
```bitbake
#@TYPE: Machine
#@DESCRIPTION: Machine configuration for the Zynq-Miami SOM.

include conf/machine/include/zynq-base.inc
include conf/machine/include/tune-cortexa9.inc
SOC_FAMILY = "zynq-miami"
require conf/machine/include/soc-family.inc

PREFERRED_PROVIDER_virtual/xilinx-sdk = "miami-xilinx-sdk"

UBOOT_MACHINE = "zynq_miami_config"

# ubiattach /dev/ubi_ctrl -m 5
# From dmesg:
# UBI: attached mtd5 (name "qspi-rootfs", size 58 MiB) to ubi0
# UBI: PEB size: 262144 bytes (256 KiB), LEB size: 262016 bytes
# UBI: min./max. I/O unit sizes: 1/256, sub-page size 1
# UBI: VID header offset: 64 (aligned 64), data offset: 128
# UBI: good PEBs: 234, bad PEBs: 0, corrupted PEBs: 0

MKUBIFS_ARGS = "-m 1 -e 262016 -c 234"
UBINIZE_ARGS = "-m 1 -p 256KiB"
UBI_VOLNAME = "qspi-rootfs"
```

## conf/machine/tdkz10.conf
```bitbake
# machine: Topic Development Kit with Zynq 7010 Lite

MACHINE_BOARD = "topic-miamilite-florida-gen"
FPGA_FAMILY = "xc7z010"
FPGA_FAMILY_SHORT = "xc7z"
FPGA_PART = "xc7z010clg400-1"

require conf/machine/include/topic-miamilite-florida.inc
```

## conf/machine/tdkz15.conf
```bitbake
# machine: Topic Development Kit with Zynq 7015

MACHINE_BOARD = "topic-miami-florida-gen"
FPGA_FAMILY = "xc7z015"
FPGA_PART = "xc7z015clg485-1"

require conf/machine/include/topic-miami-florida.inc
```

## conf/machine/tdkz30.conf
```bitbake
# machine: Topic Development Kit with Zynq 7030

MACHINE_BOARD = "topic-miami-florida-gen"
FPGA_FAMILY = "xc7z030"
FPGA_PART = "xc7z030sbg485-1"

require conf/machine/include/topic-miami-florida.inc
```

## conf/machine/tdpzu9.conf
```bitbake
# machine: Topic Developmentkit Plus with Zynq Ultrascale 9EG

FPGA_FAMILY = "xczu9eg"
FPGA_PART = "xczu9eg-ffvb1156-1-i"

require conf/machine/include/tdpzu.inc
```
