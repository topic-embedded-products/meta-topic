## conf/distro/tiny-systemd.conf
```bitbake
# Tiny distribution, using systemd
# Intended for small flash systems

# providers
PREFERRED_PROVIDER_libcrypto = "openssl"
PREFERRED_PROVIDER_libssl = "openssl"
PREFERRED_PROVIDER_jpeg = "libjpeg-turbo"
PREFERRED_PROVIDER_jpeg-native = "libjpeg-turbo-native"

DISTRO_FEATURES_INITMAN = "systemd"
# VIRTUAL-RUNTIME_dev_manager = "busybox-mdev"
# VIRTUAL-RUNTIME_login_manager = "busybox"
VIRTUAL-RUNTIME_init_manager = "${DISTRO_FEATURES_INITMAN}"
# VIRTUAL-RUNTIME_initscripts = "initscripts"
DISTRO_FEATURES_BACKFILL_CONSIDERED = "pulseaudio"
DISTRO_FEATURES = "systemd usbgadget usbhost wifi bluetooth largefile ${DISTRO_FEATURES_LIBC}"

# don't run login on root console, messes with GUI
USE_VT = "0"
YSVINIT_ENABLED_GETTYS = ""

# build some core libs with heavier compiler optimization
O3_OPT = "-O3 -pipe ${DEBUG_FLAGS}"
FULL_OPTIMIZATION_pn-libgcrypt = "${O3_OPT}"
FULL_OPTIMIZATION_pn-zlib = "${O3_OPT}"
```

## conf/distro/tiny.conf
```bitbake
# Tiny distribution, using busybox for hotplug and login.
# Intended for small flash systems

DISTRO_VERSION = "topic-tiny.0"

# providers
PREFERRED_PROVIDER_libcrypto = "openssl"
PREFERRED_PROVIDER_libssl = "openssl"
PREFERRED_PROVIDER_jpeg = "libjpeg-turbo"
PREFERRED_PROVIDER_jpeg-native = "libjpeg-turbo-native"

VIRTUAL-RUNTIME_dev_manager = "busybox-mdev"
VIRTUAL-RUNTIME_login_manager = "busybox"
VIRTUAL-RUNTIME_init_manager = "${DISTRO_FEATURES_INITMAN}"
VIRTUAL-RUNTIME_initscripts = "initscripts"

DISTRO_FEATURES_INITMAN = "sysvinit"
DISTRO_FEATURES_BACKFILL_CONSIDERED = "pulseaudio"
DISTRO_FEATURES = "ipv4 ipv6 usbgadget usbhost wifi bluetooth largefile ${DISTRO_FEATURES_LIBC}"

# don't run login on root console, messes with GUI
USE_VT = "0"
SYSVINIT_ENABLED_GETTYS = ""

# build some core libs with heavier compiler optimization
O3_OPT = "-O3 -pipe ${DEBUG_FLAGS}"
FULL_OPTIMIZATION_pn-libgcrypt = "${O3_OPT}"
FULL_OPTIMIZATION_pn-zlib = "${O3_OPT}"

# Allow licenses for gstreamer components (consult your legal department...)
LICENSE_FLAGS_WHITELIST ?= "commercial"
COMMERCIAL_AUDIO_PLUGINS ?= "gst-plugins-ugly-mad gst-plugins-ugly-mpegaudioparse"
COMMERCIAL_VIDEO_PLUGINS ?= "gst-plugins-ugly-mpeg2dec gst-plugins-ugly-mpegstream gst-plugins-bad-mpegvideoparse"

# Prevent stacking up hundreds of old builds by not including a DATETIME in the image name
IMAGE_NAME = "${IMAGE_BASENAME}-${MACHINE}"
```

## conf/layer.conf
```bitbake
# It really depends on order of the layers appearing in BBLAYERS
# variable in toplevel bblayers.conf file, where bitbake will search
# for .inc files and others where bitbake uses BBPATH since it will
# search the directories from first to last as specified in BBPATH
# Therefore if you want a given layer to be considered high priority
# for the .inc and .conf etc. then consider it adding at the beginning
# of BBPATH. For bblayers bitbake will use BBFILES_PRIORITY to resolve
# the recipe contention so the order of directories in BBFILES does 
# not matter.

# We have a conf directory, append to BBPATH
BBPATH .= ":${LAYERDIR}"

# We have a recipes directory, add to BBFILES
BBFILES += "${LAYERDIR}/recipes-*/*/*.bb ${LAYERDIR}/recipes-*/*/*.bbappend"

BBFILE_COLLECTIONS += "topic-layer"
BBFILE_PATTERN_topic-layer := "^${LAYERDIR}/"

# The miamimp boards require the "xilinx" layer to build the ATF.
LAYERDEPENDS_topic-layer = "core xilinx"
LAYERSERIES_COMPAT_topic-layer = "zeus"

# Environment to point to the meta-zynq root dir
META_ZYNQ_BASE := '${LAYERDIR}'
# Prevent relocation to lead to sstate-cache hash mismatches
META_ZYNQ_BASE[vardepvalue] = "meta-zynq"

# Use new u-boot api
PREFERRED_PROVIDER_u-boot-fw-utils = "libubootenv"
```

## conf/machine/include/tdpzu.inc
```bitbake
# machine: Topic Developmentkit Plus with Zynq Ultrascale

MACHINE_BOARD = "tdpzu"

require conf/machine/include/tspzu.inc

BOARD_PL_REFERENCE = "dtb-tdpzu-reference"

# Extra packages to install for the board
MACHINE_EXTRA_RRECOMMENDS += "\
	kernel-module-g-ether \
	kernel-module-g-mass-storage \
	kernel-module-u-ether \
	kernel-module-usb-f-ecm \
	kernel-module-usb-f-ecm-subset \
	kernel-module-usb-f-mass-storage \
	kernel-module-usb-f-rndis \
	kernel-module-topic-pl-fanctrl \
	pwm-fancontrol \
	"

MACHINE_FEATURES += "rtc usbhost usbgadget ethernet"

DEVICETREE = "devicetree/${MACHINE_BOARD}.dtb"

KERNEL_MODULE_AUTOLOAD += "g_ether"
```

## conf/machine/include/tepzu.inc
```bitbake
# machine: Topic Florida Plus v2 with Zynq Ultrascale

MACHINE_BOARD = "tepzu"

require conf/machine/include/tspzu.inc

# Override XSA, serdes and clock config is different
TOPIC_XSA_DESIGN_VERSION = "280+38e5dd1"
TOPIC_XSA_DESIGN_NAME = "fpga-hardware-${MACHINE}-reference-${TOPIC_XSA_DESIGN_VERSION}.xsa"
TOPIC_XSA_DESIGN_SHA256SUM = "40d00c0ada816b7589d54eebfeb716db8a03ad8bf0228b8e8b25e3573d6d3dd9"

BOARD_PL_REFERENCE = "dtb-tepzu-reference"

MACHINE_WIFI_DRIVERS = "\
	kernel-module-cfg80211 \
	kernel-module-mac80211 \
	kernel-module-libarc4 \
	kernel-module-iwlwifi \
	kernel-module-iwlmvm \
	linux-firmware-iwlwifi-ax200 \
	"
MACHINE_BT_DRIVERS = "\
	kernel-module-bluetooth \
	kernel-module-btmrvl \
	kernel-module-btusb \
	linux-firmware-ibt-20 \
	"

# Extra packages to install for the board
MACHINE_EXTRA_RRECOMMENDS += "\
	kernel-module-g-ether \
	kernel-module-g-mass-storage \
	kernel-module-u-ether \
	kernel-module-usb-f-ecm \
	kernel-module-usb-f-ecm-subset \
	kernel-module-usb-f-mass-storage \
	kernel-module-usb-f-rndis \
	kernel-module-topic-pl-fanctrl \
	pwm-fancontrol \
	${MACHINE_WIFI_DRIVERS} \
	${MACHINE_BT_DRIVERS} \
	"

MACHINE_FEATURES += "rtc usbhost usbgadget ethernet wifi bluetooth powerkey"

DEVICETREE = "devicetree/${MACHINE_BOARD}.dtb"

KERNEL_MODULE_AUTOLOAD += "g_ether"
```

## conf/machine/include/tepzu9/microblaze.inc
```bitbake
# /cpus_microblaze@0/cpu@0
#   compatible = "pmu-microblaze";
AVAILTUNES += "microblaze-pmu"
TUNE_FEATURES:tune-microblaze-pmu = "microblaze v9.2 barrel-shift pattern-compare reorder fpu-soft"
PACKAGE_EXTRA_ARCHS:tune-microblaze-pmu = "${TUNE_PKGARCH}"


require conf/machine/include/xilinx-microblaze.inc
```

## conf/machine/include/topic-miami-florida-med.inc
```bitbake
# Florida board common components
require conf/machine/include/topic-miami-florida.inc

# Extra drivers to load as modules
BOARD_FPGA_PACKAGES += "\
	kernel-module-ads129x \
	kernel-module-spi-cadence \
	"
```

## conf/machine/include/topic-miami-florida-test.inc
```bitbake
# Florida board common components
require conf/machine/include/topic-miami.inc

MACHINE_FPGA_BITSTREAM ?= ""

# Extra packages to install for the board
BOARD_FPGA_PACKAGES ?= "\
	kernel-module-g-ether \
	kernel-module-g-mass-storage \
	kernel-module-g-ncm \
	kernel-module-gspca-main \
	kernel-module-u-ether \
	kernel-module-pwc \
	kernel-module-usb-f-ecm \
	kernel-module-usb-f-ecm-subset \
	kernel-module-usb-f-mass-storage \
	kernel-module-usb-f-ncm \
	kernel-module-usb-f-rndis \
	kernel-module-usbserial \
	kernel-module-uvcvideo \
	kernel-module-videobuf2-core \
	kernel-module-videobuf2-dma-contig \
	kernel-module-videobuf2-memops \
	kernel-module-videobuf2-vmalloc \
	kernel-module-virtio-ring \
	kernel-module-virtio-rpmsg-bus \
	kernel-module-virtio \
	"

MACHINE_FEATURES += "usbhost usbgadget"
```

## conf/machine/include/topic-miami-florida.inc
```bitbake
# Florida board common components
require conf/machine/include/topic-miami.inc

BOARD_PL_REFERENCE = "dtb-miami-florida-gen-reference"

# Extra packages to install for the board
MACHINE_EXTRA_RRECOMMENDS += "\
	kernel-module-adi-axi-hdmi \
	kernel-module-adv7604 \
	kernel-module-axi-hdmi-rx \
	kernel-module-dma-axi-dmac \
	kernel-module-g-ether \
	kernel-module-u-ether \
	kernel-module-usb-f-ecm \
	kernel-module-usb-f-ecm-subset \
	kernel-module-usb-f-rndis \
	kernel-module-snd-hwdep \
	kernel-module-snd-soc-adi-axi-spdif \
	kernel-module-snd-soc-simple-card \
	kernel-module-vdmafb \
	kernel-module-videobuf2-dma-contig \
	kernel-module-videobuf2-memops \
	kernel-module-videobuf2-vmalloc \
	kernel-module-virt-dma \
	kernel-module-xilinx-dma \
	firmware-imageon-edid \
	"


#TODO: kernel-module-bitblit  kernel-module-snd-soc-adv7511-hdmi  	kernel-module-videobuf2-core 
KERNEL_MODULE_AUTOLOAD += "adi_axi_hdmi"
module_autoload_adi_axi_hdmi = "xilinx_dma adi_axi_hdmi snd_soc_adi_axi_spdif snd_soc_adv7511_hdmi snd_soc_simple_card"
KERNEL_MODULE_AUTOLOAD += "axi-hdmi-rx"
module_autoload_axi-hdmi-rx = "adv7604 dma-axi-dmac axi-hdmi-rx"

MACHINE_FEATURES += "usbhost usbgadget screen touchscreen wifi alsa ethernet"

DEVICETREE = "topic-miami-florida-mio.dtb"

DEVICETREELINKS = "\
	system.dtb  devicetree/${DEVICETREE} \n \
	"
```

## conf/machine/include/topic-miami-vice.inc
```bitbake
# Vice board common components
require conf/machine/include/topic-miami.inc

IMAGE_FSTYPES = "squashfs-xz"
```

## conf/machine/include/topic-miami.inc
```bitbake
#@TYPE: Machine
#@DESCRIPTION: Machine configuration for the Topic Miami SOM.
#
# Machine config is expected to set MACHINE_BOARD and FPGA_FAMILY

# The system-on-module contains flash, CPU+FPGA, RAM and various power supply
# and clock sources.
SOM_FAMILY = "topic-miami"

# The kernel only depends on the board, not the FPGA
KMACHINE = "${MACHINE_BOARD}"

include conf/machine/include/zynq-base.inc
require conf/machine/include/soc-zynq.inc
require conf/machine/include/machine-xilinx-default.inc

# Prefer to use Yocto's QEMU over Xilinx'
PREFERRED_PROVIDER_qemu-helper-native = "qemu-helper-native"
PREFERRED_PROVIDER_qemu = "qemu"
PREFERRED_PROVIDER_qemu-native = "qemu-native"
PREFERRED_PROVIDER_qemu-system-native = "qemu-system-native"
PREFERRED_PROVIDER_nativesdk-qemu = "nativesdk-qemu"

# Make Xilinx happy, we don't use it...
HDF_MACHINE = "${MACHINE}"

# tune-zynq is adding an unused zImage
KERNEL_IMAGETYPES:remove = "zImage"
# Specify LOADADDR on the commandline to build an uImage
KERNEL_EXTRA_ARGS += "UIMAGE_LOADADDR=0x8000"

MACHINEOVERRIDES =. "${SOM_FAMILY}:${MACHINE_BOARD}:${FPGA_FAMILY}:"

# Workaround for broken check on IMAGE_FEATURES in kernel recipe
FPGA_MNGR_RECONFIG_ENABLE = "1"

# There's no entropy source in the SoM, so use 'haveged' to at least make the
# ssh server start up in reasonable time.
MACHINE_ENTROPY = "haveged-once"
MACHINE_EXTRA_RDEPENDS += "${MACHINE_ENTROPY}"

# u-boot configuration
UBOOT_MACHINE = "topic_miami_config"
UBOOT_SUFFIX = "img"
SPL_BINARY = "spl/boot.bin"
SPL_SYMLINK = "BOOT.bin"
HAS_PLATFORM_INIT:append = "\
	topic_miami_config \
	topic_miamilite_config \
	topic_miamiplus_config"
# u-boot-xlnx replaces any devicetree settings with its own, so we have
# to provide the devicetree config explicitly here.
UBOOT_USER_SPECIFIED_DTS = "zynq-topic-miami"

KERNEL_MODULE_AUTOLOAD ?= ""
KERNEL_MODULE_AUTOLOAD += "g_ether spi-cadence"

MACHINE_EXTRA_RRECOMMENDS += "\
	topic-miami-monitor-lib \
	"

# Use QSPI flash with 64k sector size
MKUBIFS_ARGS = "-m 1 -e 65408 -c 496 -x zlib"
UBINIZE_ARGS = "-m 1 -p 64KiB"
UBI_VOLNAME = "qspi-rootfs"

# Xilinx borks this, "fix" that by making it empty again
MACHINE_ESSENTIAL_EXTRA_RDEPENDS = ""

# Out of kernel devicetree
PREFERRED_PROVIDER_virtual/dtb = "device-tree-static"
MACHINE_ESSENTIAL_EXTRA_RDEPENDS += "device-tree-static"

DEVICETREE ??= "devicetree/topic-miami.dtb"

# We want to use u-boot SPL
PREFERRED_PROVIDER_virtual/boot-bin = "u-boot-xlnx"

# Xilinx sets WKS_FILE_DEPENDS:append which we'll undo here. We only want boot.bin there anyway...
WKS_FILE_DEPENDS:remove = "xilinx-bootbin virtual/dtb u-boot-xlnx-scr u-boot-xlnx-uenv arm-trusted-firmware"
```

## conf/machine/include/topic-miamilite-florida.inc
```bitbake
# Florida board common components
require conf/machine/include/topic-miamilite.inc

BOARD_PL_REFERENCE = "dtb-miamilite-florida-gen-reference"

# Extra packages to install for the board
MACHINE_EXTRA_RRECOMMENDS += "\
	kernel-module-g-ether \
	kernel-module-u-ether \
	kernel-module-usb-f-ecm \
	kernel-module-usb-f-ecm-subset \
	kernel-module-usb-f-rndis \
	"


MACHINE_FEATURES += "usbhost usbgadget ethernet"

DEVICETREE = "${MACHINE}.dtb"

DEVICETREELINKS = "\
	system.dtb  devicetree/${DEVICETREE} \n \
	"
```

## conf/machine/include/topic-miamilite.inc
```bitbake
# The miami lite boards have less I/O connectors and slightly different hardware
require conf/machine/include/topic-miami.inc

# This makes the "topic-miamilite" override work
SOM_FAMILY = "topic-miamilite"

# But the "topic-miami" override applies as well, with lower priority
MACHINEOVERRIDES =. "topic-miami:"

# Different MIO configuration, hence different u-boot
UBOOT_MACHINE = "topic_miamilite_config"
```

## conf/machine/include/topic-miamimp-florida-gen.inc
```bitbake
require conf/machine/include/topic-miamimp.inc

BOARD_PL_REFERENCE = "dtb-miami-florida-gen-reference"

KERNEL_MODULE_AUTOLOAD += "g_ether spi-cadence mali"

# Extra packages to install for the board
MACHINE_EXTRA_RRECOMMENDS += "\
	kernel-module-adi-axi-hdmi \
	kernel-module-adv7604 \
	kernel-module-axi-hdmi-rx \
	kernel-module-bitblit \
	kernel-module-dma-axi-dmac \
	kernel-module-g-ether \
	kernel-module-g-mass-storage \
	kernel-module-u-ether \
	kernel-module-usb-f-ecm \
	kernel-module-usb-f-ecm-subset \
	kernel-module-usb-f-mass-storage \
	kernel-module-usb-f-rndis \
	kernel-module-videobuf2-core \
	kernel-module-videobuf2-dma-contig \
	kernel-module-videobuf2-memops \
	kernel-module-videobuf2-vmalloc \
	kernel-module-xilinx-dma \
	kernel-module-mali \
	firmware-imageon-edid \
	"

KERNEL_MODULE_AUTOLOAD += "adi_axi_hdmi"
module_autoload_adi_axi_hdmi = "xilinx_dma adi_axi_hdmi snd_soc_adi_axi_spdif snd_soc_adv7511_hdmi snd_soc_simple_card"
KERNEL_MODULE_AUTOLOAD += "axi-hdmi-rx"
module_autoload_axi-hdmi-rx = "adv7604 dma-axi-dmac axi-hdmi-rx"

MACHINE_FEATURES += "usbhost usbgadget screen"

DEVICETREE ?= "zynqmp-topic-miamimp-florida-gen.dtb"
```

## conf/machine/include/topic-miamimp-florida-test.inc
```bitbake
require conf/machine/include/topic-miamimp.inc

MACHINE_FPGA_BITSTREAM ?= ""

KERNEL_MODULE_AUTOLOAD += "g_ether"

# Extra packages to install for the board
BOARD_FPGA_PACKAGES ?= "\
	kernel-module-g-ether \
	kernel-module-g-mass-storage \
	kernel-module-g-ncm \
	kernel-module-u-ether \
	"

MACHINE_FEATURES += "usbhost usbgadget"

DEVICETREE ?= "Image-zynqmp-topic-miamimp-florida-test.dtb"
```
